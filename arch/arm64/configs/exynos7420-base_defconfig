## arch/arm64/configs/exynos7420-base_defconfig
```kconfig
# CONFIG_SWAP is not set
# CONFIG_ZONE_DMA is not set
CONFIG_SYSVIPC=y
CONFIG_NO_HZ=y
CONFIG_HIGH_RES_TIMERS=y
CONFIG_CGROUPS=y
CONFIG_CGROUP_DEBUG=y
CONFIG_CGROUP_FREEZER=y
CONFIG_CGROUP_CPUACCT=y
CONFIG_RESOURCE_COUNTERS=y
CONFIG_CGROUP_SCHED=y
CONFIG_RT_GROUP_SCHED=y
CONFIG_NAMESPACES=y
CONFIG_BLK_DEV_INITRD=y
CONFIG_CC_OPTIMIZE_FOR_SIZE=y
CONFIG_EMBEDDED=y
CONFIG_MEMORY=y
# CONFIG_SLUB_DEBUG is not set
# CONFIG_COMPAT_BRK is not set
CONFIG_PROFILING=y
CONFIG_UID_CPUTIME=y
# CONFIG_GATOR is not set
CONFIG_MODULES=y
CONFIG_MODULE_UNLOAD=y
CONFIG_MODULE_FORCE_UNLOAD=y
# CONFIG_BLK_DEV_BSG is not set
CONFIG_PARTITION_ADVANCED=y
# CONFIG_IOSCHED_DEADLINE is not set
CONFIG_ARCH_EXYNOS=y
CONFIG_ARCH_EXYNOS7=y
CONFIG_ZONE_DMA_ALLOW_CUSTOM_SIZE=y
CONFIG_ZONE_DMA_SIZE_MBYTES=512
CONFIG_SOC_EXYNOS7420=y
CONFIG_EXYNOS_ASV=y
CONFIG_EXYNOS_ASV_SUPPORT_RCC=y
# CONFIG_EXYNOS_ASV_MARGIN_TEST is not set
CONFIG_EXYNOS5_DYNAMIC_CPU_HOTPLUG=y
CONFIG_EXYNOS5_DYNAMIC_CPU_HOTPLUG_SLEEP_PREPARE=4
CONFIG_MACH_UNIVERSAL7420=y
# Add Broadcomm Wifi features
CONFIG_BROADCOM_WIFI=y
CONFIG_NL80211_TESTMODE=y
CONFIG_BCM4358=y
CONFIG_BCMDHD_FW_PATH="/system/etc/wifi/bcmdhd_sta.bin"
CONFIG_BCMDHD_NVRAM_PATH="/system/etc/wifi/nvram_net.txt"
CONFIG_BCMDHD_PREALLOC_MEMDUMP=y
CONFIG_WIRELESS=y
CONFIG_WIRELESS_EXT_SYSFS=y
CONFIG_WEXT_CORE=y
CONFIG_WEXT_PROC=y
CONFIG_CFG80211=y
CONFIG_CFG80211_DEFAULT_PS=y
CONFIG_CFG80211_ALLOW_RECONNECT=y
CONFIG_WLAN=y
CONFIG_WIFI_CONTROL_FUNC=y
CONFIG_BROADCOM_WIFI_RESERVED_MEM=y
CONFIG_CFG80211_REG_NOT_UPDATED=y
CONFIG_WIFI_MULTICAST_LOG=y
CONFIG_BCMDHD_PCIE=y
CONFIG_PCI=y
CONFIG_PCI_MSI=y
CONFIG_PCI_EXYNOS=y
CONFIG_SMP=y
CONFIG_SCHED_MC=y
CONFIG_DISABLE_CPU_SCHED_DOMAIN_BALANCE=y
CONFIG_SCHED_HMP=y
CONFIG_HMP_FAST_CPU_MASK="4-7"
CONFIG_HMP_SLOW_CPU_MASK="0-3"
CONFIG_HMP_VARIABLE_SCALE=y
CONFIG_PREEMPT=y
# CONFIG_HW_PERF_EVENTS is not set
# CONFIG_PERF_EVENTS is not set
CONFIG_ARMV7_COMPAT=y
# CONFIG_CORE_DUMP_DEFAULT_ELF_HEADERS is not set
CONFIG_COMPAT=y
CONFIG_PM_AUTOSLEEP=y
CONFIG_PM_WAKELOCKS=y
CONFIG_PM_RUNTIME=y
CONFIG_PM_RUNTIME_TEST_SYSFS=y
CONFIG_PM_DEBUG=y
CONFIG_PM_ADVANCED_DEBUG=y
CONFIG_SUSPEND_TIME=y
CONFIG_CPU_FREQ=y
CONFIG_CPU_FREQ_DEFAULT_GOV_INTERACTIVE=y
CONFIG_MODE_AUTO_CHANGE=y
CONFIG_CPU_FREQ_GOV_PERFORMANCE=y
CONFIG_CPU_FREQ_GOV_USERSPACE=y
CONFIG_ARM_EXYNOS_MP_CPUFREQ=y
CONFIG_EXYNOS_APM=y
CONFIG_EXYNOS_CL_DVFS_CPU=y
CONFIG_EXYNOS_CL_DVFS_G3D=y
CONFIG_EXYNOS_CL_DVFS_MIF=y
CONFIG_CPU_IDLE=y
CONFIG_CPU_IDLE_MULTIPLE_DRIVERS=y
CONFIG_OF_IDLE_STATES=y
CONFIG_CPU_IDLE_EXYNOS=y
CONFIG_NET=y
CONFIG_USB_USBNET=y
CONFIG_USB_NET_SMSC75XX=y
CONFIG_USB_NET_SMSC95XX=y
CONFIG_PACKET=y
CONFIG_UNIX=y
CONFIG_XFRM_USER=y
CONFIG_NET_KEY=y
CONFIG_INET=y
CONFIG_IP_MULTICAST=y
CONFIG_IP_ADVANCED_ROUTER=y
CONFIG_IP_MULTIPLE_TABLES=y
CONFIG_INET_ESP=y
CONFIG_INET_AH=y
CONFIG_INET_IPCOMP=y
CONFIG_INET_XFRM_MODE_TUNNEL=y
CONFIG_INET_XFRM_MODE_BEET=y
CONFIG_INET_XFRM_MODE_TRANSPORT=y
CONFIG_INET6_XFRM_MODE_TRANSPORT=y
CONFIG_INET6_XFRM_MODE_TUNNEL=y
CONFIG_INET6_XFRM_MODE_BEET=y
CONFIG_NETFILTER_XTABLES=y
# CONFIG_INET_LRO is not set
# CONFIG_INET_DIAG is not set
CONFIG_IPV6=y
CONFIG_IPV6_PRIVACY=y
CONFIG_IPV6_ROUTER_PREF=y
CONFIG_IPV6_ROUTE_INFO=y
CONFIG_IPV6_OPTIMISTIC_DAD=y
CONFIG_INET6_AH=y
CONFIG_INET6_ESP=y
CONFIG_INET6_IPCOMP=y
CONFIG_IPV6_MIP6=y
CONFIG_IPV6_TUNNEL=y
CONFIG_IPV6_MULTIPLE_TABLES=y
CONFIG_NETFILTER=y
CONFIG_NF_CONNTRACK=y
CONFIG_NF_CONNTRACK_EVENTS=y
CONFIG_NF_CT_PROTO_DCCP=y
CONFIG_NF_CT_PROTO_SCTP=y
CONFIG_NF_CT_PROTO_UDPLITE=y
CONFIG_NF_CONNTRACK_AMANDA=y
CONFIG_NF_CONNTRACK_FTP=y
CONFIG_NF_CONNTRACK_H323=y
CONFIG_NF_CONNTRACK_IRC=y
CONFIG_NF_CONNTRACK_NETBIOS_NS=y
CONFIG_NF_CONNTRACK_PPTP=y
CONFIG_NF_CONNTRACK_SANE=y
CONFIG_NF_CONNTRACK_TFTP=y
CONFIG_NF_CT_NETLINK=y
CONFIG_NETFILTER_TPROXY=y
CONFIG_NETFILTER_XT_TARGET_CLASSIFY=y
CONFIG_NETFILTER_XT_TARGET_CONNMARK=y
CONFIG_NETFILTER_XT_TARGET_IDLETIMER=y
CONFIG_NETFILTER_XT_TARGET_MARK=y
CONFIG_NETFILTER_XT_TARGET_NFLOG=y
CONFIG_NETFILTER_XT_TARGET_LOG=y
CONFIG_NETFILTER_XT_TARGET_NFQUEUE=y
CONFIG_NETFILTER_XT_TARGET_TPROXY=y
CONFIG_NETFILTER_XT_TARGET_TRACE=y
CONFIG_NETFILTER_XT_TARGET_TCPMSS=y
CONFIG_NETFILTER_XT_MATCH_COMMENT=y
CONFIG_NETFILTER_XT_MATCH_CONNBYTES=y
CONFIG_NETFILTER_XT_MATCH_CONNLABEL=y
CONFIG_NETFILTER_XT_MATCH_CONNLIMIT=y
CONFIG_NETFILTER_XT_MATCH_CONNMARK=y
CONFIG_NETFILTER_XT_MATCH_CONNTRACK=y
CONFIG_NETFILTER_XT_MATCH_HASHLIMIT=y
CONFIG_NETFILTER_XT_MATCH_HELPER=y
CONFIG_NETFILTER_XT_MATCH_IPRANGE=y
CONFIG_NETFILTER_XT_MATCH_LENGTH=y
CONFIG_NETFILTER_XT_MATCH_LIMIT=y
CONFIG_NETFILTER_XT_MATCH_MAC=y
CONFIG_NETFILTER_XT_MATCH_MARK=y
CONFIG_NETFILTER_XT_MATCH_POLICY=y
CONFIG_NETFILTER_XT_MATCH_PKTTYPE=y
CONFIG_NETFILTER_XT_MATCH_QTAGUID=y
CONFIG_NETFILTER_XT_MATCH_QUOTA=y
CONFIG_NETFILTER_XT_MATCH_QUOTA2=y
CONFIG_NETFILTER_XT_MATCH_QUOTA2_LOG=y
CONFIG_NETFILTER_XT_MATCH_SCTP=y
CONFIG_NETFILTER_XT_MATCH_SOCKET=y
CONFIG_NETFILTER_XT_MATCH_STATE=y
CONFIG_NETFILTER_XT_MATCH_STATISTIC=y
CONFIG_NETFILTER_XT_MATCH_STRING=y
CONFIG_NETFILTER_XT_MATCH_TIME=y
CONFIG_NETFILTER_XT_MATCH_U32=y
CONFIG_TCP_CONG_ADVANCED=y
CONFIG_TCP_CONG_BIC=y
CONFIG_DEFAULT_BIC=y
CONFIG_DEFAULT_TCP_CONG="bic"
CONFIG_NF_CONNTRACK_IPV4=y
CONFIG_IP_NF_IPTABLES=y
CONFIG_IP_NF_MATCH_AH=y
CONFIG_IP_NF_MATCH_ECN=y
CONFIG_IP_NF_MATCH_TTL=y
CONFIG_IP_NF_FILTER=y
CONFIG_IP_NF_TARGET_REJECT=y
CONFIG_IP_NF_TARGET_REJECT_SKERR=y
CONFIG_NF_NAT_IPV4=y
CONFIG_IP_NF_TARGET_MASQUERADE=y
CONFIG_IP_NF_TARGET_NETMAP=y
CONFIG_IP_NF_TARGET_REDIRECT=y
CONFIG_IP_NF_MANGLE=y
CONFIG_IP_NF_RAW=y
CONFIG_IP_NF_ARPTABLES=y
CONFIG_IP_NF_ARPFILTER=y
CONFIG_IP_NF_ARP_MANGLE=y
CONFIG_NF_CONNTRACK_IPV6=y
CONFIG_IP6_NF_IPTABLES=y
CONFIG_IP6_NF_FILTER=y
CONFIG_IP6_NF_TARGET_REJECT=y
CONFIG_IP6_NF_TARGET_REJECT_SKERR=y
CONFIG_IP6_NF_MANGLE=y
CONFIG_IP6_NF_RAW=y
CONFIG_NF_NAT_IPV6=y
CONFIG_IP6_NF_TARGET_MASQUERADE=y
CONFIG_PHONET=y
CONFIG_NET_SCH_HTB=y
CONFIG_NET_CLS_U32=y
CONFIG_NET_EMATCH_U32=y
CONFIG_BT=y
CONFIG_NET_ACT_POLICE=y
CONFIG_NET_ACT_GACT=y
CONFIG_UEVENT_HELPER_PATH="/sbin/hotplug"
CONFIG_DEVTMPFS=y
CONFIG_DMA_CMA=y
CONFIG_CMA_SIZE_MBYTES=0
CONFIG_BLK_DEV_LOOP=y
CONFIG_BLK_DEV_RAM=y
CONFIG_BLK_DEV_RAM_SIZE=8192
CONFIG_MIPI_LLI=y
CONFIG_SEC_MODEM_V1=y
CONFIG_UMTS_MODEM_SS333=y
CONFIG_INPUT_MISC=y
CONFIG_INPUT_UINPUT=y

# MUIC configs
CONFIG_USE_MUIC=y
CONFIG_USE_SAFEOUT=y
CONFIG_MUIC_NOTIFIER=y
CONFIG_MUIC_RUSTPROOF_ON_USER=y
CONFIG_MUIC_MAX77843=y
CONFIG_HV_MUIC_MAX77843_AFC=y
CONFIG_SWITCH=y
CONFIG_MUIC_ADCMODE_SWITCH_WA=y
CONFIG_MUIC_MAX77843_IGNORE_ADCERR_WA=y
CONFIG_MUIC_MAX77843_RESET_WA=y
CONFIG_VBUS_NOTIFIER=y

CONFIG_NEW_LEDS=y
CONFIG_LEDS_CLASS=y
CONFIG_LEDS_MAX77843_RGB=y
CONFIG_LEDS_USE_ED28=y
CONFIG_HALL=y
CONFIG_CERTIFY_HALL=y
CONFIG_SCSI=y
CONFIG_UFS_FMP_DM_CRYPT=y
CONFIG_UFS_FMP_ECRYPT_FS=y
CONFIG_SCFS=y
CONFIG_SCFS_LOWER_PAGECACHE_INVALIDATION=y
CONFIG_CRYPTO_LZO=y
CONFIG_BLK_DEV_SD=y
CONFIG_SCSI_MULTI_LUN=y
CONFIG_SCSI_LOWLEVEL=y
CONFIG_SCSI_UFSHCD=y
CONFIG_UFS_DYNAMIC_H8=y
CONFIG_SCSI_UFSHCD_PLATFORM=y
CONFIG_SCSI_UFS_EXYNOS=y
CONFIG_FIPS_FMP_UFS=y
CONFIG_NODE_FOR_SELFTEST_FAIL=y
CONFIG_MD=y
CONFIG_BLK_DEV_DM=y
CONFIG_DM_CRYPT=y
CONFIG_DM_VERITY=y
CONFIG_NETDEVICES=y
CONFIG_TUN=y
CONFIG_PPP=y
CONFIG_PPPOE=y
CONFIG_PPP_DEFLATE=y
CONFIG_PPP_BSDCOMP=y
CONFIG_PPP_MPPE=y
CONFIG_PPPOLAC=y
CONFIG_PPPOPNS=y
CONFIG_PPP_ASYNC=y
CONFIG_PPP_SYNC_TTY=y
CONFIG_MII=y
# CONFIG_INPUT_FF_MEMLESS is not set
# CONFIG_INPUT_MOUSEDEV is not set
CONFIG_INPUT_EVDEV=y
# CONFIG_KEYBOARD_ATKBD is not set
CONFIG_KEYBOARD_GPIO=y
# CONFIG_INPUT_MOUSE is not set
CONFIG_INPUT_TOUCHSCREEN=y
CONFIG_TOUCHSCREEN_FTS=y
CONFIG_GLOVE_TOUCH=y
CONFIG_SEC_DEBUG_TSP_LOG=y
# CONFIG_SERIO_I8042 is not set
# CONFIG_SERIO_SERPORT is not set
# CONFIG_LEGACY_PTYS is not set
# CONFIG_DEVMEM is not set
# CONFIG_DEVKMEM is not set
CONFIG_SERIAL_SAMSUNG=y
CONFIG_SERIAL_SAMSUNG_CONSOLE=y
CONFIG_S3C_LOWLEVEL_UART_PORT=2
CONFIG_HW_RANDOM=y
CONFIG_HW_RANDOM_EXYNOS_SWD=y
CONFIG_EXYRNG_FIPS_COMPLIANCE=y
CONFIG_EXYRNG_FAIL_POLICY_RESET=y
CONFIG_EXYRNG_USE_CRYPTOMANAGER=y
CONFIG_I2C=y
CONFIG_I2C_EXYNOS5=y
CONFIG_I2C_CHARDEV=y
CONFIG_I2C_GPIO=y
CONFIG_SPI=y
CONFIG_SPI_S3C64XX=y
CONFIG_SEC_GPIO_DVS=y
CONFIG_DEBUG_GPIO=y
CONFIG_GPIO_SYSFS=y
CONFIG_SENSORS_SEC_THERMISTOR=y
CONFIG_POWER_SUPPLY=y
CONFIG_BATTERY_SAMSUNG=y
CONFIG_BATTERY_SWELLING=y

# This feature supports two cases at the same time, 
# which are the one with HW IC and the other one with no IC, respectively.
CONFIG_BATTERY_SWELLING_SELF_DISCHARGING=y
# This sub feature is only eligible for Zero projects. - set to general_varient
# CONFIG_BATTERY_SWELLING_SELF_DISCHARGING_ZERO_ONLY is not set

CONFIG_INBATTERY=y
CONFIG_FUELGAUGE_MAX77843=y
CONFIG_CHARGER_MAX77843=y
CONFIG_CALC_TIME_TO_FULL=y
CONFIG_DISABLE_SAVE_CAPACITY_MAX=y
CONFIG_MOTOR_DRV_MAX77843=y
CONFIG_WIRELESS_CHARGER_INBATTERY=y
CONFIG_WIRELESS_CHARGER_INBATTERY_CS100=y
CONFIG_WIRELESS_CHARGER_BQ51221=y
CONFIG_AFC_CHARGER_MODE=y
# CONFIG_FUELGAUGE_S2MG001 is not set
CONFIG_WATCHDOG=y
CONFIG_S3C2410_WATCHDOG=y
CONFIG_MFD_MAX77843=y
CONFIG_THERMAL=y
CONFIG_CPU_THERMAL=y
CONFIG_EXYNOS_THERMAL=y
CONFIG_CPU_THERMAL_IPA=y
CONFIG_CPU_THERMAL_IPA_CONTROL=y
CONFIG_MFD_SEC_CORE=y
CONFIG_MFD_S2MPB02=y
CONFIG_REGULATOR=y
CONFIG_REGULATOR_FIXED_VOLTAGE=y
CONFIG_REGULATOR_MAX77838=y
CONFIG_REGULATOR_MAX77843=y
CONFIG_REGULATOR_S2MPS15=y
CONFIG_REGULATOR_S2MPB01=y
CONFIG_REGULATOR_S2MPB02=y
CONFIG_MEDIA_SUPPORT=y
CONFIG_MEDIA_CAMERA_SUPPORT=y
CONFIG_VIDEOBUF2_ION=y
CONFIG_V4L_PLATFORM_DRIVERS=y
CONFIG_EXYNOS_MFC_V9=y
# CONFIG_VIDEO_EXYNOS_HEVC is not set
CONFIG_ENABLE_HAL3_2_META_INTERFACE=y
CONFIG_VIDEO_EXYNOS_FIMC_IS=y
CONFIG_COMPANION_USE=y
CONFIG_COMPANION_C2_USE=y
CONFIG_COMPANION_STANDBY_USE=y
CONFIG_USE_VENDER_FEATURE=y
# CONFIG_MODULE_ALL_INCLUDE=y
CONFIG_CAMERA_SENSOR_2P2_OBJ=y
CONFIG_CAMERA_SENSOR_IMX240_OBJ=y
CONFIG_CAMERA_SENSOR_4E6_OBJ=y
CONFIG_CAMERA_SENSOR_4E6_C2_OBJ=y
CONFIG_OIS_USE=y
CONFIG_AF_HOST_CONTROL=y
CONFIG_CAMERA_EEPROM_SUPPORT_FRONT=y
CONFIG_COMPANION_DCDC_USE=y
# CONFIG_CSI_V3_2 is not set
CONFIG_CSI_V3_4=y
CONFIG_FIMC_IS_V4_0_0=y
CONFIG_VIDEO_EXYNOS_SCALER=y
CONFIG_VIDEO_EXYNOS_FIMG2D=y
CONFIG_FIMG2D_CCI_SNOOP=y
# CONFIG_VIDEO_EXYNOS_HDMI is not set
CONFIG_ARM_EXYNOS7420_BUS_DEVFREQ_TDNR=y
CONFIG_MEDIA_EXYNOS_JPEG=y
CONFIG_MALI_EXYNOS_TRACE=y
CONFIG_MALI_EXPERT=y
CONFIG_MALI_PLATFORM_THIRDPARTY=y
CONFIG_MALI_PLATFORM_THIRDPARTY_NAME="7420"
CONFIG_MALI_T7XX=y
CONFIG_MALI_R7P0=y
CONFIG_MALI_RT_PM=y
CONFIG_MALI_DVFS=y
CONFIG_MALI_ENABLE_TRACE=y
CONFIG_MALI_DEBUG_SYS=y
CONFIG_FB=y
CONFIG_MALI_TIMELINE_DISABLED=y
CONFIG_USE_VSYNC_SKIP=y
CONFIG_FB_MODE_HELPERS=y
CONFIG_DECON_MIPI_DSI_PKTGO=y
CONFIG_EXYNOS_DECON_LCD_SYSFS=y
CONFIG_FB_SIMPLE=y
CONFIG_EXYNOS_VIDEO=y
CONFIG_FB_WINDOW_UPDATE=y
CONFIG_EXYNOS_DECON=y
CONFIG_DECON_LPD_DISPLAY=y
CONFIG_EXYNOS_DECON_LCD=y
# CONFIG_SEC_MHL_SII8620 is not set
# CONFIG_MHL_VERSION is not set
CONFIG_BACKLIGHT_LCD_SUPPORT=y
CONFIG_LCD_CLASS_DEVICE=y
CONFIG_BACKLIGHT_CLASS_DEVICE=y
CONFIG_SOUND=y
CONFIG_SND=y
CONFIG_SND_USB_AUDIO=y
CONFIG_SND_SOC=y
CONFIG_SND_SOC_SAMSUNG=y
CONFIG_SND_SOC_MAX98504A=y
CONFIG_SND_SAMSUNG_SEIREN=y
CONFIG_BT_HIDP=y
CONFIG_UHID=y
CONFIG_HID=y
CONFIG_HID_OVR=y
CONFIG_HIDRAW=y
# CONFIG_HID_PID is not set
# CONFIG_USB_HIDDEV is not set
# Special HID drivers
CONFIG_HID_A4TECH=y
CONFIG_HID_ACRUX=y
# CONFIG_HID_ACRUX_FF is not set
CONFIG_HID_APPLE=y
CONFIG_HID_BELKIN=y
CONFIG_HID_CHERRY=y
CONFIG_HID_CHICONY=y
CONFIG_HID_PRODIKEYS=y
CONFIG_HID_CYPRESS=y
CONFIG_HID_DRAGONRISE=y
CONFIG_HID_EMS_FF=y
CONFIG_HID_ELECOM=y
CONFIG_HID_EZKEY=y
CONFIG_HID_KEYTOUCH=y
CONFIG_HID_KYE=y
CONFIG_HID_UCLOGIC=y
CONFIG_HID_WALTOP=y
CONFIG_HID_GYRATION=y
CONFIG_HID_TWINHAN=y
CONFIG_HID_KENSINGTON=y
CONFIG_HID_LCPOWER=y
CONFIG_HID_MAGICMOUSE=y
CONFIG_HID_MICROSOFT=y
CONFIG_HID_MONTEREY=y
CONFIG_HID_MULTITOUCH=y
CONFIG_HID_NTRIG=y
CONFIG_HID_ORTEK=y
CONFIG_HID_PANTHERLORD=y
CONFIG_HID_PETALYNX=y
CONFIG_HID_PICOLCD=y
# CONFIG_HID_PICOLCD_FB is not set
# CONFIG_HID_PICOLCD_BACKLIGHT is not set
# CONFIG_HID_PICOLCD_LCD is not set
# CONFIG_HID_PICOLCD_LEDS is not set
CONFIG_HID_QUANTA=y
CONFIG_HID_ROCCAT=y
CONFIG_HID_ROCCAT_COMMON=y
CONFIG_HID_ROCCAT_ARVO=y
CONFIG_HID_ROCCAT_KONE=y
CONFIG_HID_ROCCAT_KONEPLUS=y
CONFIG_HID_ROCCAT_KOVAPLUS=y
CONFIG_HID_ROCCAT_PYRA=y
CONFIG_HID_SAMSUNG=y
CONFIG_HID_SYNAPTICS_BT=y
CONFIG_HID_SONY=y
CONFIG_HID_SUNPLUS=y
CONFIG_HID_GREENASIA=y
CONFIG_HID_SMARTJOYPLUS=y
CONFIG_HID_TOPSEED=y
CONFIG_HID_THRUSTMASTER=y
CONFIG_HID_WACOM=y
CONFIG_HID_WACOM_POWER_SUPPLY=y
CONFIG_HID_ZAGG=y
CONFIG_HID_ZEROPLUS=y
CONFIG_HID_ZYDACRON=y
CONFIG_HID_LOGITECH=y
CONFIG_HID_LOGITECH_DJ=y
CONFIG_USB=y
CONFIG_USB_DEBUG=y
CONFIG_USB_ANNOUNCE_NEW_DEVICES=y
CONFIG_USB_NOTIFY_LAYER=y
CONFIG_USB_HOST_NOTIFY=y
CONFIG_USB_EXTERNAL_NOTIFY=y
CONFIG_USB_NOTIFIER=y
CONFIG_USB_STORAGE_DETECT=y
CONFIG_USB_DEBUG_DETAILED_LOG=y
CONFIG_USB_HMT_SAMSUNG_INPUT=y
CONFIG_USB_XHCI_HCD=y
CONFIG_USB_STORAGE=y
CONFIG_USB_PRINTER=y
CONFIG_USB_SERIAL=y
CONFIG_USB_SERIAL_PL2303=y
CONFIG_USB_DWC3=y
CONFIG_USB_PHY=y
CONFIG_SAMSUNG_USB2PHY_DUMMY=y
CONFIG_SAMSUNG_USB3PHY=y
CONFIG_USB_GADGET=y
CONFIG_USB_G_ANDROID=y
CONFIG_USB_ANDROID_SAMSUNG_COMPOSITE=y
CONFIG_USB_ANDROID_SAMSUNG_MTP=y
CONFIG_USB_DUN_SUPPORT=y
CONFIG_USBIRQ_BALANCING_LTE_HIGHTP=y
CONFIG_USB_NCM_SUPPORT_MTU_CHANGE=y
CONFIG_USB_RNDIS_MULTIPACKET=y
# CONFIG_USB_LOCK_SUPPORT_FOR_MDM is not set
CONFIG_LEDS_KTD2692=y
CONFIG_LEDS_S2MPB02=y
CONFIG_RTC_CLASS=y
# CONFIG_EXYNOS_PERSISTENT_CLOCK is not set
CONFIG_RTC_DRV_SEC=y
CONFIG_STAGING=y
CONFIG_ANDROID=y
CONFIG_ANDROID_BINDER_IPC=y
CONFIG_ASHMEM=y
CONFIG_ANDROID_LOGGER=y
CONFIG_ANDROID_LOW_MEMORY_KILLER=y
CONFIG_ANDROID_INTF_ALARM_DEV=y
CONFIG_SYNC=y
CONFIG_SW_SYNC=y
CONFIG_ION=y
CONFIG_ION_TEST=y
CONFIG_ION_EXYNOS=y
CONFIG_ION_EXYNOS_OF=y
CONFIG_EXYNOS_IOMMU_V6=y
CONFIG_PM_DEVFREQ=y
CONFIG_ARM_EXYNOS7420_BUS_DEVFREQ_ADV_MIF_THERMAL_POLLING=y
CONFIG_EXYNOS_ADC=y
CONFIG_PWM=y
CONFIG_PWM_SAMSUNG=y
CONFIG_SAMSUNG_LPM_MODE=y
CONFIG_MOBICORE_DRIVER=y
CONFIG_MOBICORE_API=y
CONFIG_SECURE_OS_CONTROL=y
CONFIG_SECURE_OS_BOOSTER_API=y
CONFIG_EXYNOS_CORESIGHT=y
CONFIG_EXT2_FS=y
CONFIG_EXT3_FS=y
CONFIG_EXT4_FS=y
CONFIG_FUSE_FS=y
CONFIG_VFAT_FS=y
CONFIG_SDCARD_FS=y
CONFIG_EXFAT_FS=y
CONFIG_TMPFS=y
#CONFIG_ECRYPT_FS is set 'ODE and DIR Encryption'
CONFIG_CRAMFS=y
CONFIG_NLS_CODEPAGE_437=y
CONFIG_NLS_ISO8859_1=y
CONFIG_PRINTK_TIME=y
CONFIG_PRINTK_PROCESS=y
CONFIG_MAGIC_SYSRQ=y
CONFIG_LOCKUP_DETECTOR=y
CONFIG_BOOTPARAM_HARDLOCKUP_PANIC=y
CONFIG_BOOTPARAM_SOFTLOCKUP_PANIC=y
# CONFIG_SLUB_DEBUG_ON is not set
# CONFIG_DEBUG_PREEMPT is not set
# CONFIG_DEBUG_RT_MUTEXES is not set
# CONFIG_DEBUG_LOCK_ALLOC is not set
# CONFIG_DEBUG_ATOMIC_SLEEP is not set
CONFIG_DEBUG_INFO=y
# CONFIG_DEBUG_LIST is not set
# CONFIG_ATOMIC64_SELFTEST is not set
# CONFIG_EARLY_PRINTK is not set
#CONFIG_KEYS is set in 'ODE and DIR Encryption'
CONFIG_CRYPTO_NULL=y

# GPS
CONFIG_GPS_BCMxxxxx=y
CONFIG_GPS_BCM47531=y

# SensorHub
#CONFIG_SENSORS_SSP_STM=y
#CONFIG_SENSORS_SSP_ATMEL=y
CONFIG_GPS_BCM4773=y
CONFIG_SENSORS_SSP_BBD=y
CONFIG_SENSORS_SSP=y
CONFIG_SENSORS_SYSFS=y
CONFIG_SENSORS_SSP_SENSORHUB=y
CONFIG_SENSORS_SSP_FACTORY=y
# CONFIG_SENSORS_SSP_BMI058 is not set
#CONFIG_SENSORS_SSP_ICM20610=y
CONFIG_SENSORS_SSP_MPU6500=y
#CONFIG_SENSORS_SSP_BMP182=y
CONFIG_SENSORS_SSP_LPS25H=y
#CONFIG_SENSORS_SSP_YAS532 is not set
CONFIG_SENSORS_SSP_YAS537=y
#CONFIG_SENSORS_SSP_TMG399x=y
CONFIG_SENSORS_SSP_TMD4903=y
CONFIG_SENSORS_SSP_IRDATA_FOR_CAMERA=y
CONFIG_SENSORS_SSP_INTERRUPT_GYRO_SENSOR=y
CONFIG_SENSORS_SSP_MOBEAM=y
CONFIG_SENSORS_SSP_SX9306=y
CONFIG_SENSORS_MULTIPLE_GLASS_TYPE=y
# CONFIG_SENSORS_SSP_MAX88921 is not set
# CONFIG_SENSORS_SSP_SHTC1=y
# CONFIG_SENSORS_SSP_SHTC1_VER="SM-G900H"
CONFIG_SENSORS_MAX86902=y
CONFIG_SENSORS_MAX_NOTCHFILTER=y
CONFIG_IIO=y
CONFIG_IIO_BUFFER=y
CONFIG_IIO_KFIFO_BUF=y
CONFIG_IIO_TRIGGER=y
#CONFIG_IIO_ST_HWMON=y

# NFC
CONFIG_NFC=y
CONFIG_SEC_NFC=y
CONFIG_SEC_NFC_IF_I2C=y
CONFIG_SEC_NFC_PRODUCT_N5=y
CONFIG_SEC_NFC_LDO_CONTROL=y
# CONFIG_SEC_NFC_CLK_REQ is not set

CONFIG_RFKILL=y
CONFIG_BT_BCM4358=y
#ODE and DIR Encryption
CONFIG_CRYPTO=y
CONFIG_CRYPTO_SHA1=y
CONFIG_CRYPTO_SHA256=y
CONFIG_CRYPTO_AES=y
CONFIG_CRYPTO_TWOFISH=y
CONFIG_CRYPTO_CBC=y
CONFIG_ECRYPT_FS=y
CONFIG_WTL_ENCRYPTION_FILTER=y
CONFIG_KEYS=y
CONFIG_KEYS_DEBUG_PROC_KEYS=y

#FIPS Cerified code merge - start
CONFIG_CRYPTO_TEST=y
CONFIG_CRYPTO_MANAGER_DISABLE_TESTS=n
CONFIG_CRYPTO_DRBG_MENU=y
CONFIG_CRYPTO_DRBG=y
CONFIG_CRYPTO_DRBG_HMAC=y
CONFIG_CRYPTO_DRBG_HASH=y
CONFIG_CRYPTO_DRBG_CTR=y
CONFIG_CRYPTO_FIPS=y
CONFIG_CRYPTO_SHA256=y
CONFIG_FMP_UFS=y
CONFIG_FIPS_FMP=y
CONFIG_CRYPTO_SHA512=y
CONFIG_CRYPTO_GCM=y
CONFIG_LOG_BUF_SHIFT=19
#FIPS Cerified code merge - end

#
# Finger print sensor
#
CONFIG_SENSORS_FINGERPRINT=y
CONFIG_SENSORS_FINGERPRINT_SYSFS=y
CONFIG_SENSORS_VFS7XXX=y
CONFIG_SENSORS_FP_SPI_GPIO="gpv7"
CONFIG_SENSORS_FP_SPI_NUMBER=4
CONFIG_SENSORS_FP_LOCKSCREEN_MODE=y

# Add SEC_MISC
CONFIG_SEC_MISC=y

#
# SELinux
#
CONFIG_EXT2_FS_XATTR=y
CONFIG_EXT2_FS_SECURITY=y
CONFIG_EXT4_FS_XATTR=y
CONFIG_EXT4_FS_SECURITY=y
CONFIG_AUDIT=y
CONFIG_SECURITY=y
CONFIG_LSM_MMAP_MIN_ADDR=4096
CONFIG_SECURITY_NETWORK=y
CONFIG_SECURITY_SELINUX=y
CONFIG_DEFAULT_SECURITY_SELINUX=y
CONFIG_NETWORK_SECMARK=y
CONFIG_NF_CONNTRACK_SECMARK=y
CONFIG_NETFILTER_XT_TARGET_CONNSECMARK=y
CONFIG_NETFILTER_XT_TARGET_SECMARK=y
CONFIG_NETFILTER_ADVANCED=y
CONFIG_IP_NF_SECURITY=y
CONFIG_AUDITSYSCALL=y
CONFIG_SEC_AVC_LOG=y
CONFIG_SDCARD_FS_XATTR=y
CONFIG_ECRYPT_FS_VIRTUAL_FAT_XATTR=y
CONFIG_FAT_VIRTUAL_XATTR=y
CONFIG_EXFAT_VIRTUAL_XATTR=y

# Suppport /proc/device-tree
CONFIG_PROC_DEVICETREE=y
# Samsung Argos
CONFIG_ARGOS=y
# SEC feature
CONFIG_SEC_SLOW_MODE=y

# SEC BSP
CONFIG_SEC_BSP=y

# SEC Param
CONFIG_SEC_PARAM=y

#EPDG
CONFIG_NET_CORE=y
CONFIG_NET_SCH_PRIO=y
CONFIG_NET_SCHED=y   #depends on CONFIG_NET  which is enabled by default.. coz not seeing in the config file
CONFIG_NET_CLS_BASIC=y # required if basic is being used as a filter. depends on CONFIG_NET_CLS so enabling it by default
CONFIG_NET_CLS=y
CONFIG_NET_CLS_ACT=y # for enabling the action target.
CONFIG_NET_ACT_MIRRED=y  # for enabling the mirred target for redirecting the packet between the devices.
CONFIG_NET_EMATCH=y   #basic uses extended matches so this has to be present
CONFIG_NET_SCH_INGRESS=y # classifier for ingress packet
#EPDG

# Rooting prevention
#
CONFIG_SEC_RESTRICT_ROOTING=y
CONFIG_SEC_RESTRICT_SETUID=y
CONFIG_SEC_RESTRICT_FORK=y
CONFIG_SEC_RESTRICT_ROOTING_LOG=y
# TIMA
#
CONFIG_SEC_DEBUG_TIMA_LOG=y
CONFIG_TIMA=y
# CONFIG_ARM_PATCH_PHYS_VIRT is not set
# CONFIG_FUNCTION_TRACER is not set
CONFIG_TIMA_RKP=y
CONFIG_RKP_KDP=y
CONFIG_RKP_NS_PROT=y
CONFIG_RKP_DMAP_PROT=y

# KNOX KAP
CONFIG_KNOX_KAP=y

# Support ARM64 Accelerated Cryptographic Algorithms
CONFIG_ARM64_CRYPTO=y
CONFIG_CRYPTO_SHA1_ARM64_CE=y
CONFIG_CRYPTO_AES_ARM64_CE=y
CONFIG_CRYPTO_AES_ARM64_CE_BLK=y

# KNOX SDP and DLP
CONFIG_SDP=y
CONFIG_DLP=y

#TUI
CONFIG_TRUSTONIC_TRUSTED_UI=y

CONFIG_SEC_DEBUG=y

# User version reset tracking
CONFIG_USER_RESET_DEBUG=y

# DMVerity
CONFIG_DM_VERITY=y

CONFIG_DEFERRED_INITCALLS=y

#MST SECURE GPIO
CONFIG_MST_SECURE_GPIO=y

# SEC OOM KILLER
CONFIG_SEC_OOM_KILLER=y

#
# BlowFish TZDEV
#
# CONFIG_TZDEV is not set
CONFIG_TZDEV_32BIT_SECURE_KERNEL=y
CONFIG_TZDEV_USE_ARM_CALLING_CONVENTION=y
# CONFIG_TZDEV_CMA is not set
CONFIG_TZDEV_IWI_EVENT=446
CONFIG_TZDEV_IWI_PANIC=447
# CONFIG_TZDEV_SWD_PANIC_IS_CRITICAL is not set
# CONFIG_TZDEV_NWD_PANIC_ON_CLOSE is not set
CONFIG_TZLOG=y
# CONFIG_TZLOG_POLLING is not set
# CONFIG_TZLOG_POLLING_PERIOD is not set
CONFIG_TZLOG_PG_CNT=2
CONFIG_TZDEV_MULTI_CORE_AUX_CHANNELS=y
# CONFIG_TZDEV_MSM_CRYPTO_WORKAROUND is not set
# CONFIG_TZDEV_QC_CRYPTO_CLOCKS_MANAGEMENT is not set
# CONFIG_TZDEV_QC_CRYPTO_CLOCKS_USR_MNG is not set
CONFIG_ION_FD2PHYS=y
CONFIG_TZIRS=y
# CONFIG_QCOM_SCM_ARMV8 is not set
# CONFIG_TZ_CORE_MIGRATION is not set
CONFIG_TZDEV_PAGE_MIGRATION=y

CONFIG_SECCOMP=y
```

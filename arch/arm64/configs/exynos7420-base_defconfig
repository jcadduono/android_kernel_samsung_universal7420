## arch/arm64/configs/exynos7420-eng_defconfig
```kconfig
# CONFIG_MUIC_RUSTPROOF_ON_USER is not set
#
# Kernel Performance Events and Counters
#
CONFIG_SLUB_DEBUG=y

#
# SAMSUNG EXYNOS SoCs Support
#
CONFIG_EXYNOS_ASV_MARGIN_TEST=y

#
# Kernel hacking
#
CONFIG_SLUB_DEBUG_ON=y
# CONFIG_DEBUG_KMEMLEAK is not set
CONFIG_DEBUG_PREEMPT=y
CONFIG_DEBUG_RT_MUTEXES=y
CONFIG_DEBUG_PI_LIST=y
CONFIG_DEBUG_SPINLOCK=y
CONFIG_DEBUG_MUTEXES=y
CONFIG_DEBUG_LOCK_ALLOC=y
CONFIG_PROVE_LOCKING=y
CONFIG_DEBUG_ATOMIC_SLEEP=y
CONFIG_DEBUG_STACK_USAGE=y
CONFIG_DEBUG_MEMORY_INIT=y
CONFIG_DEBUG_LIST=y
CONFIG_DEBUG_SG=y
CONFIG_TIMER_STATS=y
CONFIG_SCHEDSTATS=y
CONFIG_SEC_FILE_LEAK_DEBUG=y

#
# RCU Debugging
#
# CONFIG_DEBUG_PAGEALLOC is not set
CONFIG_ATOMIC64_SELFTEST=y

#
# Samsung Rooting Restriction Feature
#
# CONFIG_SEC_RESTRICT_ROOTING is not set
# CONFIG_SEC_RESTRICT_SETUID is not set
# CONFIG_SEC_RESTRICT_FORK is not set
# CONFIG_SEC_RESTRICT_ROOTING_LOG is not set

#
# Common Clock Framework
#
CONFIG_COMMON_CLK_DEBUG=y
CONFIG_DYNAMIC_DEBUG=y
CONFIG_TIMER_STATS=y

#
# TIMA RKP CRED Protection
#
# CONFIG_RKP_KDP is not set

#
# BCMDHD Debugging
#
CONFIG_BCMDHD_DEBUG_PAGEALLOC=y

# Samsung modem interface debugging
CONFIG_SEC_MODEM_DEBUG=y
CONFIG_SEC_MODEM_DEBUGFS=y

# Samsung modem interface MDM MHI driver RMNET DUMP
CONFIG_MHI_RMNET_DUMP=y

# Samsung audio debugfs
CONFIG_SND_SAMSUNG_DEBUGFS=y
CONFIG_SND_SOC_ES_STREAM_FS_STORER=y

CONFIG_HW_PERF_EVENTS=y
CONFIG_PERF_EVENTS=y
CONFIG_FTRACE=y
CONFIG_HIGH_RES_TIMERS=y
CONFIG_HW_PERF_EVENTS=y
CONFIG_LOCAL_TIMERS=y
CONFIG_LOCAL_TIMERS=y
CONFIG_GATOR=m

#
# Support T32 onchip breakpoint
#
CONFIG_SKIP_HW_BREAKPOINT=y

# BAT Automation Test Feature
CONFIG_SEC_BAT_AUT=y

#
# Character devices
#
CONFIG_DEVMEM=y
```

## arch/arm64/configs/exynos7420-userdebug_defconfig
```kconfig
#
# Kernel Performance Events and Counters
#
# CONFIG_SLUB_DEBUG is not set
# CONFIG_PROFILING is not set

#
# SAMSUNG EXYNOS SoCs Support
#
# CONFIG_EXYNOS_ASV_MARGIN_TEST is not set

#
# Kernel hacking
#
# CONFIG_SLUB_DEBUG_ON is not set
# CONFIG_DEBUG_KMEMLEAK is not set
# CONFIG_DEBUG_PREEMPT is not set
# CONFIG_DEBUG_RT_MUTEXES is not set
# CONFIG_DEBUG_PI_LIST is not set
# CONFIG_DEBUG_SPINLOCK is not set
# CONFIG_DEBUG_MUTEXES is not set
# CONFIG_DEBUG_LOCK_ALLOC is not set
# CONFIG_PROVE_LOCKING is not set
# CONFIG_DEBUG_ATOMIC_SLEEP is not set
# CONFIG_DEBUG_STACK_USAGE is not set
# CONFIG_DEBUG_LIST is not set
# CONFIG_DEBUG_SG is not set

#
# RCU Debugging
#
# CONFIG_DEBUG_PAGEALLOC is not set
# CONFIG_ATOMIC64_SELFTEST is not set

#
# Samsung Rooting Restriction Feature
#
# CONFIG_SEC_RESTRICT_ROOTING is not set
# CONFIG_SEC_RESTRICT_SETUID is not set
# CONFIG_SEC_RESTRICT_FORK is not set
# CONFIG_SEC_RESTRICT_ROOTING_LOG is not set
CONFIG_SYSFS=y
CONFIG_BLOCK=y
CONFIG_TRACING_SUPPORT=y
CONFIG_FTRACE=y
# mmc_add_trace() is not defined
# CONFIG_BLK_DEV_IO_TRACE is not set
CONFIG_FUNCTION=y
CONFIG_FUNCTION_GRAPH=y

#
# Common Clock Framework
#
CONFIG_COMMON_CLK_DEBUG=y
CONFIG_DYNAMIC_DEBUG=y
CONFIG_TIMER_STATS=y

#
# TIMA RKP CRED Protection
#
# CONFIG_RKP_KDP is not set

#
# BCMDHD Debugging
#
CONFIG_BCMDHD_DEBUG_PAGEALLOC=y

#
# PKTLOG Debugging
#
CONFIG_DEBUG_PKTLOG=y
```

## arch/arm64/configs/noblelte/device_defconfig
```kconfig
CONFIG_ARM_EXYNOS7420_BUS_DEVFREQ_TDNR=y
CONFIG_BATTERY_AGE_FORECAST=y
CONFIG_BCM4359=y
CONFIG_BCMDHD_PCIE=y
CONFIG_BCMDHD_PREALLOC_PKTIDMAP=y
CONFIG_BOUNCE=y
CONFIG_BT_BCM4359=y
CONFIG_CAMERA_NOBLE=y
CONFIG_CHARGER_MAX77833=y
CONFIG_DSIM_ESD_RECOVERY_NOPOWER=y
CONFIG_EPEN_WACOM_W9014=y
CONFIG_ESE_P3_LSI=y
CONFIG_FUELGAUGE_MAX77833=y
CONFIG_GPS_BCM47531=y
CONFIG_GPS_BCMxxxxx=y
CONFIG_HV_MUIC_MAX77833_AFC=y
CONFIG_INPUT_WACOM=y
CONFIG_KEYBOARD_ABOV_TOUCH=y
CONFIG_KEYBOARD_CYPRESS_TOUCH_MBR31X5=y
CONFIG_LCD_BURNIN_CORRECTION=y
CONFIG_LCD_HMT=y
CONFIG_LEDS_MAX77833_RGB=y
CONFIG_MFD_MAX77833=y
CONFIG_MOTOR_DRV_MAX77833=y
CONFIG_MST_NOBLE_TARGET=y
CONFIG_MUIC_MAX77833_SHAKEID_WA=y
CONFIG_MUIC_MAX77833=y
CONFIG_PANEL_S6E3HA3_DYNAMIC=y
CONFIG_REGULATOR_MAX77833=y
CONFIG_SEC_NFC_IF_I2C=y
CONFIG_SEC_NFC_LDO_CONTROL=y
CONFIG_SEC_NFC_PRODUCT_N5=y
CONFIG_SEC_NFC=y
CONFIG_SENSORS_SSP_NOBLELTE=y
CONFIG_SND_ESA_SA_EFFECT=y
CONFIG_SND_SAMSUNG_COMPR=y
CONFIG_SND_SAMSUNG_ELPE=y
CONFIG_SND_SAMSUNG_SEIREN_DMA=y
CONFIG_SND_SAMSUNG_SEIREN_OFFLOAD=y
CONFIG_SND_SOC_ARIZONA=y
CONFIG_SND_SOC_CLEARWATER=y
CONFIG_SND_SOC_SAMSUNG_NOBLE_CLEARWATER=y
CONFIG_SND_SOC_WM_ADSP=y
CONFIG_SWITCH_ANTENNA=y
CONFIG_TOUCHSCREEN_FTS5AD56=y
CONFIG_WIRELESS_CHARGER_HIGH_VOLTAGE=y
CONFIG_WIRELESS_CHARGER_MAX77900=y
CONFIG_WIRELESS_CHARGER_P9220=y
CONFIG_WIRELESS_CHARGER_THM=y
CONFIG_WLAIBSS=y
CONFIG_WL_RELMCAST=y
CONFIG_ZONE_DMA_ALLOW_CUSTOM_SIZE=y
CONFIG_ZONE_DMA_FLAG=1
CONFIG_ZONE_DMA_SIZE_MBYTES=512
CONFIG_ZONE_DMA=y
```

## arch/arm64/configs/noblelte/variant_tmo_defconfig
```kconfig
CONFIG_EXYNOS_MIPI_LLI_MPHY=y
CONFIG_EXYNOS_MIPI_LLI=y
CONFIG_LINK_CONTROL_MSG_COMMAND=y
CONFIG_LINK_DEVICE_LLI=y
CONFIG_LINK_DEVICE_MEMORY=y
CONFIG_LINK_DEVICE_SPI=y
CONFIG_LINK_DEVICE_WITH_SBD_ARCH=y
CONFIG_LINK_POWER_MANAGEMENT_WITH_FSM=y
CONFIG_LINK_POWER_MANAGEMENT=y
CONFIG_MIPI_LLI=y
CONFIG_SEC_MODEM_V1=y
CONFIG_SENSORS_SSP_BBD=y
CONFIG_SENSORS_SSP_K6DS3TR=y
CONFIG_SENSORS_SSP_LPS25H=y
CONFIG_SENSORS_SSP_YAS537=y
CONFIG_SENSORS_SX9310_CP_LDO_CONTROL=y
CONFIG_SENSORS_SX9310_INIT_TOUCH_THRESHOLD=2000
CONFIG_SENSORS_SX9310_NORMAL_TOUCH_THRESHOLD=248
CONFIG_SENSORS_SX9310=y
CONFIG_SND_SOC_ES705=y
CONFIG_SND_SOC_ES_I2C=y
CONFIG_SND_SOC_ES_STREAM_FS_STORER=y
CONFIG_SND_SOC_ESXXX_UPDATE_VEQ_TABLE=y
CONFIG_SWITCH_ANTENNA_IF=y
CONFIG_UMTS_MODEM_SS333=y
CONFIG_WLAN_REGION_CODE=100
```

## arch/arm64/configs/noblelte/variant_usc_defconfig
```kconfig
CONFIG_DIAG_CHAR=y
CONFIG_DIAGFWD_BRIDGE_CODE=y
CONFIG_DIAG_OVER_USB=y
CONFIG_ESOC_CLIENT=y
CONFIG_ESOC_DEV=y
CONFIG_ESOC_MDM_4x=y
CONFIG_ESOC_MDM_DRV=y
CONFIG_ESOC=y
CONFIG_I2C_RTC6213N=y
CONFIG_IPC_ROUTER_SECURITY=y
CONFIG_IPC_ROUTER=y
CONFIG_MDM_HSIC_PM=y
CONFIG_MEDIA_RADIO_SUPPORT=y
CONFIG_MEDIA_TUNER_MC44S803=y
CONFIG_MEDIA_TUNER_MT20XX=y
CONFIG_MEDIA_TUNER_SIMPLE=y
CONFIG_MEDIA_TUNER_TDA18271=y
CONFIG_MEDIA_TUNER_TDA827X=y
CONFIG_MEDIA_TUNER_TDA8290=y
CONFIG_MEDIA_TUNER_TDA9887=y
CONFIG_MEDIA_TUNER_TEA5761=y
CONFIG_MEDIA_TUNER_TEA5767=y
CONFIG_MEDIA_TUNER_XC2028=y
CONFIG_MEDIA_TUNER_XC4000=y
CONFIG_MEDIA_TUNER_XC5000=y
CONFIG_MEDIA_TUNER=y
CONFIG_MHI=y
CONFIG_MSM_HSIC_SYSMON=y
CONFIG_MSM_IPC_ROUTER_HSIC_XPRT=y
CONFIG_MSM_QMI_INTERFACE=y
CONFIG_MSM_SUBSYSTEM_RESTART=y
CONFIG_MSM_SYSMON_COMM=y
CONFIG_PCI_EXYNOS_REDUCE_RESET_WAIT=y
CONFIG_QMI_ENCDEC=y
CONFIG_RADIO_ADAPTERS=y
CONFIG_RADIO_RTC6213N=y
CONFIG_RMNET_DATA_DEBUG_PKT=y
CONFIG_RMNET_DATA=y
CONFIG_SAMSUNG_USB2PHY_CAL=y
CONFIG_SAMSUNG_USB2PHY=y
CONFIG_SEC_DEBUG_MDM_SEPERATE_CRASH=y
CONFIG_SENSORS_SSP_AK09911=y
CONFIG_SENSORS_SSP_ATUC128L5HAR=y
CONFIG_SENSORS_SSP_BMI168=y
CONFIG_SENSORS_SSP_BMP280=y
CONFIG_SENSORS_SSP_STM=y
CONFIG_SENSORS_SX9310_CP_LDO_CONTROL=y
CONFIG_SENSORS_SX9310_INIT_TOUCH_THRESHOLD=2000
CONFIG_SENSORS_SX9310_NORMAL_TOUCH_THRESHOLD=248
CONFIG_SENSORS_SX9310=y
CONFIG_SND_SOC_ES705=y
CONFIG_SND_SOC_ES_I2C=y
CONFIG_SND_SOC_ES_STREAM_FS_STORER=y
CONFIG_SND_SOC_ESXXX_UPDATE_VEQ_TABLE=y
CONFIG_SND_SOC_ESXXX_VEQ_EXTENDEDVOLUME=y
CONFIG_SWITCH_ANTENNA_EARJACK=y
CONFIG_USB_EHCI_HCD=y
CONFIG_USB_EHCI_PCI=y
CONFIG_USB_EHCI_S5P=y
CONFIG_USB_EHCI_TT_NEWSCHED=y
CONFIG_USB_QCOM_DIAG_BRIDGE=y
CONFIG_USB_QCOM_IPC_BRIDGE=y
CONFIG_USB_QCOM_KS_BRIDGE=y
CONFIG_USB_QCOM_MDM_BRIDGE=y
CONFIG_USB_SERIAL_CSVT=y
CONFIG_WLAN_REGION_CODE=100
```

## arch/arm64/configs/noblelte/variant_zt_defconfig
```kconfig
CONFIG_CHECK_GPIO_DETECT=y
CONFIG_CHECK_SIMSLOT_COUNT=y
CONFIG_EXYNOS_MIPI_LLI_MPHY=y
CONFIG_EXYNOS_MIPI_LLI=y
CONFIG_LINK_CONTROL_MSG_COMMAND=y
CONFIG_LINK_DEVICE_LLI=y
CONFIG_LINK_DEVICE_MEMORY=y
CONFIG_LINK_DEVICE_SPI=y
CONFIG_LINK_DEVICE_WITH_SBD_ARCH=y
CONFIG_LINK_POWER_MANAGEMENT_WITH_FSM=y
CONFIG_LINK_POWER_MANAGEMENT=y
CONFIG_MIPI_LLI=y
CONFIG_NFC_P61=y
CONFIG_NFC_PN547_ESE_SUPPORT=y
CONFIG_NFC_PN547_LDO_CONTROL=y
CONFIG_NFC_PN547=y
CONFIG_OIS_FW_UPDATE_THREAD_USE=y
CONFIG_SEC_MODEM_V1=y
CONFIG_SENSORS_SSP_BBD=y
CONFIG_SENSORS_SSP_K6DS3TR=y
CONFIG_SENSORS_SSP_LPS25H=y
CONFIG_SENSORS_SSP_SX9306=y
CONFIG_SENSORS_SSP_YAS537=y
CONFIG_SENSORS_SX9310_CP_LDO_CONTROL=y
CONFIG_SENSORS_SX9310_INIT_TOUCH_THRESHOLD=2000
CONFIG_SENSORS_SX9310_NORMAL_TOUCH_THRESHOLD=248
CONFIG_SENSORS_SX9310=y
CONFIG_SWITCH_ANTENNA_EARJACK=y
CONFIG_UMTS_MODEM_SS333=y
CONFIG_USB_LOCK_SUPPORT_FOR_MDM=y
CONFIG_WLAN_REGION_CODE=300
```

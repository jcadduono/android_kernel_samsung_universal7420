## arch/arm64/configs/universal7420_defconfig
```kconfig
# CONFIG_SWAP is not set
CONFIG_SYSVIPC=y
CONFIG_NO_HZ=y
CONFIG_HIGH_RES_TIMERS=y
CONFIG_CGROUPS=y
CONFIG_CGROUP_DEBUG=y
CONFIG_CGROUP_FREEZER=y
CONFIG_CGROUP_CPUACCT=y
CONFIG_RESOURCE_COUNTERS=y
CONFIG_CGROUP_SCHED=y
CONFIG_RT_GROUP_SCHED=y
CONFIG_NAMESPACES=y
CONFIG_BLK_DEV_INITRD=y
CONFIG_CC_OPTIMIZE_FOR_SIZE=y
CONFIG_EMBEDDED=y
CONFIG_MEMORY=y
# CONFIG_COMPAT_BRK is not set
CONFIG_PROFILING=y
CONFIG_MODULES=y
CONFIG_MODULE_UNLOAD=y
CONFIG_MODULE_FORCE_UNLOAD=y
# CONFIG_BLK_DEV_BSG is not set
CONFIG_PARTITION_ADVANCED=y
# CONFIG_IOSCHED_DEADLINE is not set
CONFIG_ARCH_EXYNOS=y
CONFIG_ZONE_DMA_ALLOW_CUSTOM_SIZE=y
CONFIG_ZONE_DMA_SIZE_MBYTES=512
CONFIG_ARCH_EXYNOS7=y
CONFIG_SOC_EXYNOS7420=y
CONFIG_EXYNOS_ASV=y
CONFIG_EXYNOS_ASV_SUPPORT_RCC=y
CONFIG_EXYNOS5_DYNAMIC_CPU_HOTPLUG=y
CONFIG_MACH_UNIVERSAL7420=y
CONFIG_PCI=y
CONFIG_PCI_EXYNOS=y
CONFIG_PCI_EXYNOS_TEST=y
CONFIG_PCI_MSI=y
CONFIG_SMP=y
CONFIG_SCHED_MC=y
CONFIG_DISABLE_CPU_SCHED_DOMAIN_BALANCE=y
CONFIG_SCHED_HMP=y
CONFIG_HMP_FAST_CPU_MASK="4-7"
CONFIG_HMP_SLOW_CPU_MASK="0-3"
CONFIG_HMP_VARIABLE_SCALE=y
CONFIG_PREEMPT=y
# CONFIG_HW_PERF_EVENTS is not set
# CONFIG_CORE_DUMP_DEFAULT_ELF_HEADERS is not set
CONFIG_COMPAT=y
CONFIG_PM_AUTOSLEEP=y
CONFIG_PM_WAKELOCKS=y
CONFIG_PM_RUNTIME=y
CONFIG_PM_RUNTIME_TEST_SYSFS=y
CONFIG_CPU_FREQ=y
CONFIG_CPU_FREQ_DEFAULT_GOV_INTERACTIVE=y
CONFIG_CPU_FREQ_GOV_PERFORMANCE=y
CONFIG_CPU_FREQ_GOV_USERSPACE=y
CONFIG_ARM_EXYNOS_MP_CPUFREQ=y
CONFIG_CPU_IDLE=y
CONFIG_CPU_IDLE_MULTIPLE_DRIVERS=y
CONFIG_OF_IDLE_STATES=y
CONFIG_CPU_IDLE_EXYNOS=y
CONFIG_EXYNOS_APM=y
CONFIG_EXYNOS_CL_DVFS_CPU=y
CONFIG_EXYNOS_CL_DVFS_G3D=y
CONFIG_EXYNOS_CL_DVFS_MIF=y
CONFIG_NET=y
CONFIG_PACKET=y
CONFIG_UNIX=y
CONFIG_NET_KEY=y
CONFIG_INET=y
CONFIG_IP_ADVANCED_ROUTER=y
CONFIG_IP_MULTIPLE_TABLES=y
CONFIG_IP_PNP=y
CONFIG_IP_PNP_DHCP=y
CONFIG_IP_PNP_BOOTP=y
CONFIG_IP_PNP_RARP=y
CONFIG_INET_ESP=y
# CONFIG_INET_XFRM_MODE_TUNNEL is not set
# CONFIG_INET_XFRM_MODE_BEET is not set
# CONFIG_INET_LRO is not set
# CONFIG_INET_DIAG is not set
CONFIG_IPV6=y
CONFIG_IPV6_PRIVACY=y
CONFIG_IPV6_ROUTER_PREF=y
CONFIG_IPV6_OPTIMISTIC_DAD=y
CONFIG_INET6_AH=y
CONFIG_INET6_ESP=y
CONFIG_INET6_IPCOMP=y
CONFIG_IPV6_MIP6=y
CONFIG_IPV6_TUNNEL=y
CONFIG_IPV6_MULTIPLE_TABLES=y
CONFIG_NETFILTER=y
CONFIG_NF_CONNTRACK=y
CONFIG_NF_CONNTRACK_EVENTS=y
CONFIG_NF_CT_PROTO_DCCP=y
CONFIG_NF_CT_PROTO_SCTP=y
CONFIG_NF_CT_PROTO_UDPLITE=y
CONFIG_NF_CONNTRACK_AMANDA=y
CONFIG_NF_CONNTRACK_FTP=y
CONFIG_NF_CONNTRACK_H323=y
CONFIG_NF_CONNTRACK_IRC=y
CONFIG_NF_CONNTRACK_NETBIOS_NS=y
CONFIG_NF_CONNTRACK_PPTP=y
CONFIG_NF_CONNTRACK_SANE=y
CONFIG_NF_CONNTRACK_TFTP=y
CONFIG_NF_CT_NETLINK=y
CONFIG_NETFILTER_XT_TARGET_CLASSIFY=y
CONFIG_NETFILTER_XT_TARGET_CONNMARK=y
CONFIG_NETFILTER_XT_TARGET_MARK=y
CONFIG_NETFILTER_XT_TARGET_NFLOG=y
CONFIG_NETFILTER_XT_TARGET_NFQUEUE=y
CONFIG_NETFILTER_XT_MATCH_COMMENT=y
CONFIG_NETFILTER_XT_MATCH_CONNBYTES=y
CONFIG_NETFILTER_XT_MATCH_CONNLABEL=y
CONFIG_NETFILTER_XT_MATCH_CONNLIMIT=y
CONFIG_NETFILTER_XT_MATCH_CONNMARK=y
CONFIG_NETFILTER_XT_MATCH_CONNTRACK=y
CONFIG_NETFILTER_XT_MATCH_HASHLIMIT=y
CONFIG_NETFILTER_XT_MATCH_HELPER=y
CONFIG_NETFILTER_XT_MATCH_IPRANGE=y
CONFIG_NETFILTER_XT_MATCH_LENGTH=y
CONFIG_NETFILTER_XT_MATCH_LIMIT=y
CONFIG_NETFILTER_XT_MATCH_MAC=y
CONFIG_NETFILTER_XT_MATCH_MARK=y
CONFIG_NETFILTER_XT_MATCH_POLICY=y
CONFIG_NETFILTER_XT_MATCH_PKTTYPE=y
CONFIG_NETFILTER_XT_MATCH_QUOTA=y
CONFIG_NETFILTER_XT_MATCH_QUOTA2=y
CONFIG_NETFILTER_XT_MATCH_QUOTA2_LOG=y
CONFIG_NETFILTER_XT_MATCH_SCTP=y
CONFIG_NETFILTER_XT_MATCH_STATE=y
CONFIG_NETFILTER_XT_MATCH_STATISTIC=y
CONFIG_NETFILTER_XT_MATCH_STRING=y
CONFIG_NETFILTER_XT_MATCH_TIME=y
CONFIG_NETFILTER_XT_MATCH_U32=y
CONFIG_NF_CONNTRACK_IPV4=y
CONFIG_IP_NF_IPTABLES=y
CONFIG_IP_NF_MATCH_AH=y
CONFIG_IP_NF_MATCH_ECN=y
CONFIG_IP_NF_MATCH_TTL=y
CONFIG_IP_NF_FILTER=y
CONFIG_IP_NF_TARGET_REJECT=y
CONFIG_IP_NF_TARGET_REJECT_SKERR=y
CONFIG_NF_NAT_IPV4=y
CONFIG_IP_NF_TARGET_MASQUERADE=y
CONFIG_IP_NF_TARGET_NETMAP=y
CONFIG_IP_NF_TARGET_REDIRECT=y
CONFIG_IP_NF_MANGLE=y
CONFIG_IP_NF_RAW=y
CONFIG_IP_NF_ARPTABLES=y
CONFIG_IP_NF_ARPFILTER=y
CONFIG_IP_NF_ARP_MANGLE=y
CONFIG_NF_CONNTRACK_IPV6=y
CONFIG_IP6_NF_IPTABLES=y
CONFIG_IP6_NF_FILTER=y
CONFIG_IP6_NF_TARGET_REJECT=y
CONFIG_IP6_NF_TARGET_REJECT_SKERR=y
CONFIG_IP6_NF_MANGLE=y
CONFIG_IP6_NF_RAW=y
CONFIG_PHONET=y
CONFIG_NET_SCHED=y
CONFIG_NET_SCH_HTB=y
CONFIG_NET_SCH_INGRESS=y
CONFIG_NET_CLS_U32=y
CONFIG_NET_EMATCH=y
CONFIG_NET_EMATCH_U32=y
CONFIG_NET_CLS_ACT=y
CONFIG_NET_ACT_POLICE=y
CONFIG_NET_ACT_GACT=y
CONFIG_NET_ACT_MIRRED=y
CONFIG_UEVENT_HELPER_PATH="/sbin/hotplug"
CONFIG_DEVTMPFS=y
CONFIG_DMA_CMA=y
CONFIG_CMA_SIZE_MBYTES=0
CONFIG_BLK_DEV_RAM=y
CONFIG_BLK_DEV_RAM_SIZE=8192
CONFIG_MIPI_LLI=y
CONFIG_USE_MUIC=y
CONFIG_USE_SAFEOUT=y
CONFIG_MUIC_NOTIFIER=y
CONFIG_MUIC_MAX77843=y
CONFIG_SCSI=y
CONFIG_BLK_DEV_SD=y
CONFIG_SCSI_MULTI_LUN=y
# CONFIG_SCSI_LOWLEVEL is not set
CONFIG_MD=y
CONFIG_BLK_DEV_DM=y
CONFIG_DM_CRYPT=y
CONFIG_NETDEVICES=y
CONFIG_MII=y
CONFIG_INPUT_EVDEV=y
CONFIG_KEYBOARD_GPIO=y
CONFIG_KEYBOARD_SAMSUNG=y
# CONFIG_INPUT_MOUSE is not set
CONFIG_INPUT_TOUCHSCREEN=y
CONFIG_TOUCHSCREEN_FTS=y
# CONFIG_SERIO_I8042 is not set
# CONFIG_SERIO_SERPORT is not set
CONFIG_LEGACY_PTY_COUNT=16
CONFIG_SERIAL_SAMSUNG=y
CONFIG_SERIAL_SAMSUNG_CONSOLE=y
CONFIG_S3C_LOWLEVEL_UART_PORT=1
CONFIG_HW_RANDOM=y
CONFIG_HW_RANDOM_EXYNOS_SWD=y
CONFIG_EXYRNG_FIPS_COMPLIANCE=y
CONFIG_EXYRNG_FAIL_POLICY_RESET=y
CONFIG_EXYRNG_USE_CRYPTOMANAGER=y
CONFIG_I2C=y
CONFIG_I2C_EXYNOS5=y
CONFIG_I2C_GPIO=y
CONFIG_SPI=y
CONFIG_SPI_S3C64XX=y
CONFIG_DEBUG_GPIO=y
CONFIG_FUELGAUGE_S2MG001=y
# CONFIG_HWMON is not set
CONFIG_WATCHDOG=y
CONFIG_S3C2410_WATCHDOG=y
CONFIG_MFD_MAX77843=y
CONFIG_THERMAL=y
CONFIG_CPU_THERMAL=y
CONFIG_EXYNOS_THERMAL=y
CONFIG_CPU_THERMAL_IPA=y
CONFIG_CPU_THERMAL_IPA_CONTROL=y
CONFIG_MFD_SEC_CORE=y
CONFIG_REGULATOR=y
CONFIG_REGULATOR_FIXED_VOLTAGE=y
CONFIG_REGULATOR_S2MPS15=y
CONFIG_REGULATOR_S2MPB01=y
CONFIG_MEDIA_SUPPORT=y
CONFIG_MEDIA_CAMERA_SUPPORT=y
CONFIG_VIDEOBUF2_ION=y
CONFIG_V4L_PLATFORM_DRIVERS=y
CONFIG_EXYNOS_MFC_V9=y
# CONFIG_VIDEO_EXYNOS_HEVC is not set
CONFIG_VIDEO_EXYNOS_FIMC_IS=y
CONFIG_COMPANION_USE=y
CONFIG_USE_VENDER_FEATURE=y
CONFIG_MODULE_ALL=y
# CONFIG_CSI_V3_2 is not set
CONFIG_CSI_V3_4=y
CONFIG_FIMC_IS_V4_0_0=y
CONFIG_VIDEO_EXYNOS_SCALER=y
CONFIG_VIDEO_EXYNOS_FIMG2D=y
CONFIG_FIMG2D_CCI_SNOOP=y
CONFIG_MEDIA_EXYNOS_JPEG=y
CONFIG_MALI_EXYNOS_TRACE=y
CONFIG_MALI_EXPERT=y
CONFIG_MALI_PLATFORM_THIRDPARTY_NAME="7420"
CONFIG_MALI_T7XX=y
CONFIG_MALI_RT_PM=y
CONFIG_MALI_DVFS=y
CONFIG_MALI_ENABLE_TRACE=y
CONFIG_MALI_DEBUG_SYS=y
CONFIG_FB=y
CONFIG_DECON_MIPI_DSI_PKTGO=y
CONFIG_FB_SIMPLE=y
CONFIG_EXYNOS_VIDEO=y
CONFIG_FB_WINDOW_UPDATE=y
CONFIG_EXYNOS_DECON=y
CONFIG_EXYNOS_DECON_LCD=y
CONFIG_EXYNOS_DECON_LCD_S6E3HF2=y
CONFIG_BACKLIGHT_LCD_SUPPORT=y
CONFIG_LCD_CLASS_DEVICE=y
CONFIG_BACKLIGHT_CLASS_DEVICE=y
CONFIG_SOUND=y
CONFIG_SND=y
CONFIG_SND_SOC=y
CONFIG_SND_SOC_SAMSUNG=y
CONFIG_SND_SOC_SAMSUNG_UNIVERSAL7420_DUMMY=y
CONFIG_SND_SAMSUNG_SEIREN=y
CONFIG_USB=y
CONFIG_USB_XHCI_HCD=y
CONFIG_USB_PRINTER=y
CONFIG_USB_STORAGE=y
CONFIG_USB_HOST_NOTIFY=y
CONFIG_USB_NOTIFY_LAYER=y
CONFIG_USB_NOTIFIER=y
CONFIG_USB_DWC3=y
CONFIG_USB_SERIAL=y
CONFIG_USB_SERIAL_PL2303=y
CONFIG_USB_PHY=y
CONFIG_SAMSUNG_USB2PHY_DUMMY=y
CONFIG_SAMSUNG_USB3PHY=y
CONFIG_USB_GADGET=y
CONFIG_USB_G_ANDROID=y
CONFIG_MMC=y
CONFIG_MMC_UNSAFE_RESUME=y
CONFIG_MMC_DW=y
CONFIG_MMC_FMP=y
CONFIG_MMC_DW_FMP_DM_CRYPT=y
CONFIG_MMC_DW_FMP_ECRYPT_FS=y
CONFIG_MMC_DW_IDMAC=y
CONFIG_MMC_DW_64_IDMAC=y
CONFIG_MMC_DW_EXYNOS=y
CONFIG_MMC_CLKGATE=y
CONFIG_MMC_DW_SKIP_CACHE_OP=y
CONFIG_RTC_CLASS=y
CONFIG_RTC_DRV_SEC=y
CONFIG_STAGING=y
CONFIG_ANDROID=y
CONFIG_ANDROID_BINDER_IPC=y
CONFIG_ASHMEM=y
CONFIG_ANDROID_LOGGER=y
CONFIG_ANDROID_LOW_MEMORY_KILLER=y
CONFIG_ANDROID_INTF_ALARM_DEV=y
CONFIG_SYNC=y
CONFIG_SW_SYNC=y
CONFIG_ION=y
CONFIG_ION_TEST=y
CONFIG_ION_EXYNOS=y
CONFIG_ION_EXYNOS_OF=y
CONFIG_SEC_EXT=y
# CONFIG_SEC_SYSFS is not set
# CONFIG_SEC_DEBUG is not set
# CONFIG_SEC_PM is not set
CONFIG_EXYNOS_IOMMU_V6=y
CONFIG_PM_DEVFREQ=y
CONFIG_IIO=y
CONFIG_EXYNOS_ADC=y
CONFIG_PWM=y
CONFIG_PWM_SAMSUNG=y
CONFIG_BATTERY_SAMSUNG=y
CONFIG_FUELGAUGE_MAX77843=y
CONFIG_CHARGER_MAX77843=y
CONFIG_SAMSUNG_LPM_MODE=y
CONFIG_MOBICORE_DRIVER=y
CONFIG_MOBICORE_API=y
CONFIG_SECURE_OS_CONTROL=y
CONFIG_SECURE_OS_BOOSTER_API=y
CONFIG_EXYNOS_CORESIGHT=y
CONFIG_EXT2_FS=y
CONFIG_EXT3_FS=y
CONFIG_EXT4_FS=y
CONFIG_FUSE_FS=y
CONFIG_VFAT_FS=y
CONFIG_SDCARD_FS=y
CONFIG_EXFAT_FS=y
CONFIG_TMPFS=y
CONFIG_ECRYPT_FS=y
CONFIG_CRAMFS=y
CONFIG_NLS_CODEPAGE_437=y
CONFIG_NLS_ISO8859_1=y
CONFIG_PRINTK_TIME=y
CONFIG_PRINTK_PROCESS=y
CONFIG_LOCKUP_DETECTOR=y
CONFIG_BOOTPARAM_HARDLOCKUP_PANIC=y
CONFIG_BOOTPARAM_SOFTLOCKUP_PANIC=y
CONFIG_SLUB_DEBUG_ON=y
CONFIG_DEBUG_RT_MUTEXES=y
CONFIG_DEBUG_LOCK_ALLOC=y
CONFIG_DEBUG_ATOMIC_SLEEP=y
CONFIG_DEBUG_INFO=y
CONFIG_DEBUG_LIST=y
CONFIG_ATOMIC64_SELFTEST=y
# CONFIG_EARLY_PRINTK is not set
CONFIG_KEYS=y
```

## arch/arm64/configs/zenlte/variant_kor_defconfig
```kconfig
CONFIG_CRYPTO_XCBC=y
CONFIG_DEFAULT_MPTCP_SCHED="default"
CONFIG_ESE_P3_LSI=y
CONFIG_EXYNOS_MIPI_LLI_MPHY=y
CONFIG_EXYNOS_MIPI_LLI=y
CONFIG_LINK_CONTROL_MSG_COMMAND=y
CONFIG_LINK_DEVICE_LLI=y
CONFIG_LINK_DEVICE_MEMORY=y
CONFIG_LINK_DEVICE_SPI=y
CONFIG_LINK_DEVICE_WITH_SBD_ARCH=y
CONFIG_LINK_POWER_MANAGEMENT_WITH_FSM=y
CONFIG_LINK_POWER_MANAGEMENT=y
CONFIG_MIPI_LLI=y
CONFIG_MPTCP=y
CONFIG_SEC_MODEM_V1=y
CONFIG_SEC_NFC_IF_I2C=y
CONFIG_SEC_NFC_LDO_CONTROL=y
CONFIG_SEC_NFC_PRODUCT_N5=y
CONFIG_SEC_NFC=y
CONFIG_SENSORS_SSP_BBD=y
CONFIG_SENSORS_SSP_K6DS3TR=y
CONFIG_SENSORS_SSP_LPS25H=y
CONFIG_SENSORS_SSP_YAS537=y
CONFIG_SWITCH_ANTENNA_EARJACK=y
CONFIG_TCP_CONG_LIA=y
CONFIG_TCP_CONG_OLIA=y
CONFIG_TCP_CONG_WVEGAS=y
CONFIG_TDMB_MTV319=y
CONFIG_TDMB_SLSI=y
CONFIG_TDMB_SPI=y
CONFIG_TDMB_VENDOR_RAONTECH=y
CONFIG_TDMB=y
CONFIG_UMTS_MODEM_SS333=y
CONFIG_WLAN_REGION_CODE=200
```

## arch/arm64/configs/zeroflte/variant_eur_defconfig
```kconfig
CONFIG_BATTERY_SWELLING_SELF_DISCHARGING_ZERO_ONLY=y
CONFIG_CHECK_SIMSLOT_COUNT=y
CONFIG_ESE_P3_LSI=y
CONFIG_EXYNOS_MIPI_LLI_MPHY=y
CONFIG_EXYNOS_MIPI_LLI=y
CONFIG_LINK_CONTROL_MSG_COMMAND=y
CONFIG_LINK_DEVICE_LLI=y
CONFIG_LINK_DEVICE_MEMORY=y
CONFIG_LINK_DEVICE_SPI=y
CONFIG_LINK_DEVICE_WITH_SBD_ARCH=y
CONFIG_LINK_POWER_MANAGEMENT_WITH_FSM=y
CONFIG_LINK_POWER_MANAGEMENT=y
CONFIG_MIPI_LLI=y
CONFIG_SEC_MODEM_V1=y
CONFIG_SEC_NFC_IF_I2C=y
CONFIG_SEC_NFC_LDO_CONTROL=y
CONFIG_SEC_NFC_PRODUCT_N5=y
CONFIG_SEC_NFC=y
CONFIG_SENSORS_SSP_BBD=y
CONFIG_SENSORS_SSP_LPS25H=y
CONFIG_SENSORS_SSP_MPU6500=y
CONFIG_SENSORS_SSP_SX9306=y
CONFIG_SENSORS_SSP_YAS537=y
CONFIG_SWITCH_ANTENNA_EARJACK=y
CONFIG_SWITCH_ANTENNA=y
CONFIG_UMTS_MODEM_SS333=y
CONFIG_WLAN_REGION_CODE=100
```

## arch/arm64/configs/zeroflte/variant_skt_defconfig
```kconfig
CONFIG_CHARGER_MAX77833=y
CONFIG_DEFAULT_MPTCP_SCHED="default"
CONFIG_ESE_P3_LSI=y
CONFIG_EXYNOS_MIPI_LLI_MPHY=y
CONFIG_EXYNOS_MIPI_LLI=y
CONFIG_FUELGAUGE_MAX77833=y
CONFIG_GPS_BCM47531=y
CONFIG_GPS_BCMxxxxx=y
CONFIG_HV_MUIC_MAX77833_AFC=y
CONFIG_LEDS_MAX77833_RGB=y
CONFIG_LINK_CONTROL_MSG_COMMAND=y
CONFIG_LINK_DEVICE_LLI=y
CONFIG_LINK_DEVICE_MEMORY=y
CONFIG_LINK_DEVICE_SPI=y
CONFIG_LINK_DEVICE_WITH_SBD_ARCH=y
CONFIG_LINK_POWER_MANAGEMENT_WITH_FSM=y
CONFIG_LINK_POWER_MANAGEMENT=y
CONFIG_MFD_MAX77833=y
CONFIG_MIPI_LLI=y
CONFIG_MOTOR_DRV_MAX77833=y
CONFIG_MPTCP=y
CONFIG_MUIC_MAX77833_SHAKEID_WA=y
CONFIG_MUIC_MAX77833=y
CONFIG_REGULATOR_MAX77833=y
CONFIG_SEC_MODEM_V1=y
CONFIG_SEC_NFC_IF_I2C=y
CONFIG_SEC_NFC_LDO_CONTROL=y
CONFIG_SEC_NFC_PRODUCT_N5=y
CONFIG_SEC_NFC=y
CONFIG_SENSORS_SSP_BBD=y
CONFIG_SENSORS_SSP_LPS25H=y
CONFIG_SENSORS_SSP_MPU6500=y
CONFIG_SENSORS_SSP_SX9306=y
CONFIG_SENSORS_SSP_YAS537=y
CONFIG_TCP_CONG_LIA=y
CONFIG_TCP_CONG_OLIA=y
CONFIG_TCP_CONG_WVEGAS=y
CONFIG_TDMB_FC8080=y
CONFIG_TDMB_SLSI=y
CONFIG_TDMB_SPI=y
CONFIG_TDMB_VENDOR_FCI=y
CONFIG_TDMB=y
CONFIG_UMTS_MODEM_SS333=y
CONFIG_WLAN_REGION_CODE=201
```

## arch/arm64/configs/zerolte/device_defconfig
```kconfig
CONFIG_BCM4358=y
CONFIG_BCMDHD_PCIE=y
CONFIG_BT_BCM4358=y
CONFIG_CAMERA_ZERO=y
CONFIG_CHARGER_MAX77843=y
CONFIG_DISABLE_SAVE_CAPACITY_MAX=y
CONFIG_EXYNOS_DECON_LCD_MCD=y
CONFIG_FIX_CHG_FQ_4MHZ=y
CONFIG_FUELGAUGE_MAX77843=y
CONFIG_HV_MUIC_MAX77843_AFC=y
CONFIG_LCD_ALPM=y
CONFIG_LCD_HMT=y
CONFIG_LEDS_MAX77843_RGB=y
CONFIG_MFD_FLORIDA=y
CONFIG_MFD_MAX77843=y
CONFIG_MOTOR_DRV_MAX77843=y
CONFIG_MUIC_ADCMODE_SWITCH_WA=y
CONFIG_MUIC_MAX77843_IGNORE_ADCERR_WA=y
CONFIG_MUIC_MAX77843_RESET_WA=y
CONFIG_MUIC_MAX77843=y
CONFIG_PANEL_S6E3HF2_DYNAMIC=y
CONFIG_REGULATOR_MAX77843=y
CONFIG_SEC_OOM_KILLER=y
CONFIG_SND_SOC_ARIZONA=y
CONFIG_SND_SOC_CLEARWATER=y
CONFIG_SND_SOC_FLORIDA=y
CONFIG_SND_SOC_SAMSUNG_ZERO_CLEARWATER=y
CONFIG_SND_SOC_SAMSUNG_ZERO_FLORIDA=y
CONFIG_SND_SOC_WM_ADSP=y
CONFIG_TOUCHSCREEN_FTS=y
CONFIG_WIRELESS_CHARGER_BQ51221=y
CONFIG_WIRELESS_CHARGER_INBATTERY=y
CONFIG_WLAIBSS=y
CONFIG_WL_RELMCAST=y
```

## arch/arm64/configs/zerolte/variant_can_defconfig
```kconfig
CONFIG_CHARGER_MAX77833=y
CONFIG_ESE_P3_LSI=y
CONFIG_EXYNOS_MIPI_LLI_MPHY=y
CONFIG_EXYNOS_MIPI_LLI=y
CONFIG_FUELGAUGE_MAX77833=y
CONFIG_GPS_BCM47531=y
CONFIG_GPS_BCMxxxxx=y
CONFIG_HV_MUIC_MAX77833_AFC=y
CONFIG_LEDS_MAX77833_RGB=y
CONFIG_LINK_CONTROL_MSG_COMMAND=y
CONFIG_LINK_DEVICE_LLI=y
CONFIG_LINK_DEVICE_MEMORY=y
CONFIG_LINK_DEVICE_SPI=y
CONFIG_LINK_DEVICE_WITH_SBD_ARCH=y
CONFIG_LINK_POWER_MANAGEMENT_WITH_FSM=y
CONFIG_LINK_POWER_MANAGEMENT=y
CONFIG_MFD_MAX77833=y
CONFIG_MIPI_LLI=y
CONFIG_MOTOR_DRV_MAX77833=y
CONFIG_MUIC_MAX77833_SHAKEID_WA=y
CONFIG_MUIC_MAX77833=y
CONFIG_REGULATOR_MAX77833=y
CONFIG_SEC_MODEM_V1=y
CONFIG_SEC_NFC_IF_I2C=y
CONFIG_SEC_NFC_LDO_CONTROL=y
CONFIG_SEC_NFC_PRODUCT_N5=y
CONFIG_SEC_NFC=y
CONFIG_SENSORS_HALL_IRQ_CTRL=y
CONFIG_SENSORS_SSP_BBD=y
CONFIG_SENSORS_SSP_LPS25H=y
CONFIG_SENSORS_SSP_MPU6500=y
CONFIG_SENSORS_SSP_SX9306=y
CONFIG_SENSORS_SSP_YAS537=y
CONFIG_SND_SOC_ES705=y
CONFIG_SND_SOC_ES_I2C=y
CONFIG_UMTS_MODEM_SS333=y
CONFIG_WLAN_REGION_CODE=100
```

## arch/arm64/configs/zerolte/variant_usc_defconfig
```kconfig
CONFIG_BOUNCE=y
CONFIG_CHARGER_MAX77833=y
CONFIG_DIAG_CHAR=y
CONFIG_DIAGFWD_BRIDGE_CODE=y
CONFIG_DIAG_OVER_USB=y
CONFIG_ESE_P3_LSI=y
CONFIG_ESOC_CLIENT=y
CONFIG_ESOC_DEV=y
CONFIG_ESOC_MDM_4x=y
CONFIG_ESOC_MDM_DRV=y
CONFIG_ESOC=y
CONFIG_FUELGAUGE_MAX77833=y
CONFIG_HV_MUIC_MAX77833_AFC=y
CONFIG_IPC_ROUTER_SECURITY=y
CONFIG_IPC_ROUTER=y
CONFIG_LEDS_MAX77833_RGB=y
CONFIG_MDM_HSIC_PM=y
CONFIG_MFD_MAX77833=y
CONFIG_MHI=y
CONFIG_MOTOR_DRV_MAX77833=y
CONFIG_MSM_HSIC_SYSMON=y
CONFIG_MSM_IPC_ROUTER_HSIC_XPRT=y
CONFIG_MSM_QMI_INTERFACE=y
CONFIG_MSM_SUBSYSTEM_RESTART=y
CONFIG_MSM_SYSMON_COMM=y
CONFIG_MUIC_MAX77833_SHAKEID_WA=y
CONFIG_MUIC_MAX77833=y
CONFIG_PCI_EXYNOS_REDUCE_RESET_WAIT=y
CONFIG_QMI_ENCDEC=y
CONFIG_REGULATOR_MAX77833=y
CONFIG_RMNET_DATA_DEBUG_PKT=y
CONFIG_RMNET_DATA=y
CONFIG_SAMSUNG_USB2PHY_CAL=y
CONFIG_SAMSUNG_USB2PHY=y
CONFIG_SEC_DEBUG_MDM_SEPERATE_CRASH=y
CONFIG_SEC_NFC_IF_I2C=y
CONFIG_SEC_NFC_LDO_CONTROL=y
CONFIG_SEC_NFC_PRODUCT_N5=y
CONFIG_SEC_NFC=y
CONFIG_SENSORS_SSP_AK09911=y
CONFIG_SENSORS_SSP_ATUC128L5HAR=y
CONFIG_SENSORS_SSP_BMP280=y
CONFIG_SENSORS_SSP_MPU6500=y
CONFIG_SENSORS_SSP_STM=y
CONFIG_SND_SOC_ES705=y
CONFIG_SND_SOC_ES_I2C=y
CONFIG_SND_SOC_ESXXX_VEQ_EXTENDEDVOLUME=y
CONFIG_SWITCH_ANTENNA_EARJACK_IF=y
CONFIG_SWITCH_ANTENNA=y
CONFIG_USB_EHCI_HCD=y
CONFIG_USB_EHCI_PCI=y
CONFIG_USB_EHCI_S5P=y
CONFIG_USB_EHCI_TT_NEWSCHED=y
CONFIG_USB_QCOM_DIAG_BRIDGE=y
CONFIG_USB_QCOM_IPC_BRIDGE=y
CONFIG_USB_QCOM_KS_BRIDGE=y
CONFIG_USB_QCOM_MDM_BRIDGE=y
CONFIG_USB_SERIAL_CSVT=y
CONFIG_WLAN_REGION_CODE=100
CONFIG_ZONE_DMA_ALLOW_CUSTOM_SIZE=y
CONFIG_ZONE_DMA_FLAG=1
CONFIG_ZONE_DMA_SIZE_MBYTES=512
CONFIG_ZONE_DMA=y
```

## security/mst_ftmdrv/Kconfig
```kconfig
#
config MST_FTM
	def_bool y
	depends on SEC_FACTORY

config MST_NOBLE_TARGET
	def_bool n
	bool "mst solution for noble target"

config MST_ZEN_TARGET
	def_bool n
	bool "mst solution for zen target"
```
